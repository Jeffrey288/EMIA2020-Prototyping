#include <Adafruit_GFX.h>     // Core graphics library
#include <Adafruit_ST7735.h>  // Hardware-specific library
#include <SPI.h>
// #include <Keypad.h>

extern volatile unsigned long timer0_overflow_count;
unsigned long ticks() { return timer0_overflow_count; }
#define AlignCenter(len, scale) ((128 - (len) * 8 * (scale)) / 2)


const PROGMEM uint8_t scan_face[12 * 96] = {
    0x00, 0x00, 0x00, 0x00, 0x00, 0x00, 0x00, 0x00, 0x00, 0x00, 0x00, 0x00, 
    0x00, 0x00, 0x00, 0x00, 0x00, 0x00, 0x00, 0x00, 0x00, 0x00, 0x00, 0x00, 
    0x00, 0x00, 0x00, 0x00, 0x00, 0x00, 0x00, 0x00, 0x00, 0x00, 0x00, 0x00, 
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    0x00, 0x00, 0x00, 0x00, 0x00, 0x00, 0x00, 0x00, 0x00, 0x00, 0x00, 0x00, 
};

const PROGMEM uint8_t scan_bracelet[12 * 96] = {
    0x00, 0x00, 0x00, 0x00, 0x00, 0x00, 0x00, 0x00, 0x00, 0x00, 0x00, 0x00, 
    0x00, 0x00, 0x00, 0x00, 0x00, 0x00, 0x00, 0x00, 0x00, 0x00, 0x00, 0x00, 
    0x00, 0x00, 0x00, 0x00, 0x00, 0x00, 0x00, 0x00, 0x00, 0x00, 0x00, 0x00, 
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    0x00, 0x00, 0x00, 0x00, 0x00, 0x00, 0x00, 0x00, 0x00, 0x00, 0x00, 0x00, 
};

const PROGMEM uint8_t shopping_cart[10 * 62] = {
    0x00, 0x00, 0x00, 0x00, 0x00, 0x00, 0x00, 0x00, 0x00, 0x00, 
    0x0f, 0xff, 0x00, 0x00, 0x00, 0x00, 0x00, 0x00, 0x00, 0x00, 
    0x0f, 0xff, 0xc0, 0x00, 0x00, 0x00, 0x00, 0x00, 0x00, 0x00, 
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    0x00, 0x00, 0x00, 0x00, 0x00, 0x00, 0x00, 0x00, 0x00, 0x00, 
};

#define TFT_CS 10
#define TFT_RST 8  // Or set to -1 and connect to Arduino RESET pin
#define TFT_DC 9

Adafruit_ST7735 tft = Adafruit_ST7735(TFT_CS, TFT_DC, TFT_RST);

// TFT FUNCTIONS

void tft_printi(short x, short y, short w, short h, const uint8_t *img) { // assumes that w is divisible by 8
    uint16_t *colorArray = new uint16_t[w];
    // uint16_t color;
    for (int r = 0; r < h; r++) {
        for (int c = 0; c < w; c++) {
            colorArray[c] = ((pgm_read_byte_near(img + (c/8) + r * (w/8)) >> (7- c%8)) & 0x01) ? ST7735_BLACK : ST7735_WHITE; 
        }
        tft.startWrite();
        tft.drawRGBBitmap(x, y + r, colorArray, w, 1);
        tft.endWrite();
    }
    delete colorArray;
}

void tft_printc(short x, short y, const char chr, uint16_t color = ST7735_BLACK, uint16_t bg = ST7735_WHITE) {
    static uint16_t colorArray[8 * 16];
    int counter = 0;
    for (int r = 0; r < 16; r++) {
        uint8_t temp = pgm_read_word_near(asciiBitmap[chr - ' '] + r);
        for (int c = 0; c < 8; c++) {
            colorArray[counter++] = (temp & 0x01) ? color : bg;
            temp >>= 1;
        }
    }
    tft.startWrite();
    tft.drawRGBBitmap(x, y, colorArray, 8, 16);
    tft.endWrite();
}

void _tft_printbigc(short x, short y, const char chr, short w = 8, short h = 16, uint16_t color = ST7735_BLACK, uint16_t bg = ST7735_WHITE) {
    uint16_t *colorArray = new uint16_t[w];
    for (int r = 0; r < h; r++) {
        int rr = (r + 0.5) / h * 16;
        uint8_t temp = pgm_read_word_near(asciiBitmap[chr - ' '] + rr);
        for (int c = 0; c < w; c++) {
            int cc = (c + 0.5) / w * 8;
            colorArray[c] = ((temp >> (cc)) & 0x01) ? color : bg;
        }
        tft.startWrite();
        tft.drawRGBBitmap(x, y+r, colorArray, w, 1);
        tft.endWrite();
    }
    delete colorArray;
}

void tft_prints(short x, short y, const char *str, uint16_t color = ST7735_BLACK, uint16_t bg = ST7735_WHITE) {
    int counter = 0;
    while (*str != '\0') {
        tft_printc(x + 8*(counter++), y, *(str++), color, bg);
    }
}

void _tft_printbigs(short x, short y, const char *str, short w = 8, short h = 16, uint16_t color = ST7735_BLACK, uint16_t bg = ST7735_WHITE) {
    int counter = 0;
    while (*str != '\0') {
        _tft_printbigc(x + w*(counter++), y, *(str++), w, h, color, bg);
    }
}

void tft_printbigs(short x, short y, const char *str, float scale = 1.0, uint16_t color = ST7735_BLACK, uint16_t bg = ST7735_WHITE) {
    int w = scale * 8;
    int h = scale * 16;
    _tft_printbigs(x, y, str, w, h, color, bg);
}
typedef enum {
    IDLE_STATE, // enter money
    SCAN_FACE,
    SCAN_BRACELET,
    HAPPY_SHOPPING,
} States;
States state = IDLE_STATE;

const byte ROWS = 4; 
const byte COLS = 4; 

char hexaKeys[ROWS][COLS] = {
  {'1', '2', '3', 'A'},
  {'4', '5', '6', 'B'},
  {'7', '8', '9', 'C'},
  {'*', '0', '#', 'D'}
};

byte rowPins[ROWS] = {7, 6, 5, 4}; 
byte colPins[COLS] = {3, 2, PIN_A0, PIN_A1}; 

// Keypad customKeypad = Keypad(makeKeymap(hexaKeys), rowPins, colPins, ROWS, COLS);

typedef enum {
    BTN_UP,
    BTN_DOWN,
} ButtonState;

typedef enum {
    BTN_PRESSED,
    BTN_HELD,
    BTN_RELEASED,
} ButtonEvent;

typedef struct {
    void (*eventListener)(int);
    uint8_t pin;
    uint32_t last_pressed;
    uint16_t debounce_time;
    ButtonState state;
} Button;

Button start_btn;

void startBtnEventListener(int evt) {

    if (evt == 0 || evt == 2) {
        if (state == IDLE_STATE) {
            tft.fillScreen(ST77XX_WHITE);
            state = SCAN_FACE;
        } else if (state == SCAN_FACE) {
            tft_printbigs(AlignCenter(8, 1.5), 50, "SUCCESS!", 1.5, ST7735_BLACK, ST7735_GREEN);
            _delay_ms(500);
            state = SCAN_BRACELET;
        }
    }

}

void setup(void) {
    start_btn.pin = 2;
    start_btn.state = BTN_UP;
    start_btn.last_pressed = 0;
    start_btn.debounce_time = 75;
    start_btn.eventListener = startBtnEventListener;

    Serial.begin(9600);
    tft.initR(INITR_144GREENTAB);  // Init ST7735R chip, green tab
    // tft.fillScreen(ST77XX_BLACK);
    tft.setRotation(0);  // set display orientation
    pinMode(LED_BUILTIN, OUTPUT); // pull down
    pinMode(2, INPUT_PULLUP);
    tft.fillScreen(ST77XX_WHITE);
    start_btn.state = digitalRead(start_btn.pin) ? BTN_UP : BTN_DOWN;
}

char buff[20];

void loop() {
    // customKeypad.getKey();

    ButtonState tempState = digitalRead(start_btn.pin) ? BTN_UP : BTN_DOWN;
    if (tempState == BTN_DOWN) {
        start_btn.last_pressed = ticks();
        if (start_btn.state == BTN_UP) {
            start_btn.state = BTN_DOWN;
            start_btn.eventListener(0);
        } else {
            start_btn.eventListener(1);
        }
    } else {
        if (start_btn.state == BTN_DOWN) {
            if (ticks() - start_btn.last_pressed > start_btn.debounce_time) {
                start_btn.eventListener(2);
                start_btn.state = BTN_UP;
            } else {
                start_btn.eventListener(1);
            }
        }
    }

    if (state == IDLE_STATE) {
        tft_prints(AlignCenter(10, 1), 0, "Welcome to", ST7735_BLUE);
        tft_prints(AlignCenter(11, 1), 16, "TKO Market!", ST7735_BLUE);
        tft_printbigs(AlignCenter(5, 1.5), 50, "Press", 1.5, ST7735_MAGENTA);
        tft_printbigs(AlignCenter(6, 1.5), 74, "START!", 1.5, ST7735_MAGENTA);
        // if (digitalRead(2))
        //     tft_prints(0, 32, "Start button pressed!"); 
        // else
        //     tft_prints(0, 32, "Start button NOT pressed!"); 
        // sprintf(buff, "ticks:%d", ticks());
        // tft_prints(0, 64, buff);
    } else if (state == SCAN_FACE) {
        tft_prints(4, 0, "Look at CAMERA!", ST7735_RED);
        tft_printi(16, 16, 96, 96, scan_face);
    } else if (state == SCAN_BRACELET) {
        tft.fillScreen(ST77XX_WHITE);
        tft_prints(0, 0, "Processing", ST7735_RED);
        tft_prints(0, 16, "bracelet...", ST7735_RED);
        tft_printi(16, 32, 96, 96, scan_bracelet);
        _delay_ms(1500);
        state = HAPPY_SHOPPING;
    } else if (state == HAPPY_SHOPPING) {
        tft.fillScreen(ST77XX_WHITE);
        tft_printi(24, 128 - 62 - 3, 80, 62, shopping_cart);
        tft_printbigs(0, 0, "Take your", 1.2, ST7735_RED, ST7735_YELLOW);
        tft_printbigs(0, 20, "Bracelet!", 1.2, ST7735_RED, ST7735_YELLOW);
        tft_printbigs(AlignCenter(15, 0.9), 40, "Happy Shopping!", 0.9, ST7735_BLUE);
        _delay_ms(2500);
        state = IDLE_STATE;
        tft.fillScreen(ST77XX_WHITE);
    }
}

